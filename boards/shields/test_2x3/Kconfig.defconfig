## boards/shields/test_2x3/Kconfig.defconfig
```kconfig
if SHIELD_TEST_2X3

config ZMK_KEYBOARD_NAME
    default "2x3_test"

endif # SHIELD_TEST_2X3
```

## config/boards/shields/handwired_12x4/Kconfig.shield
```kconfig
config SHIELD_HANDWIRED_12X4
    def_bool $(shields_list_contains,handwired_12x4)
```

## config/west.yml
```yaml
manifest:
  remotes:
    - name: zmkfirmware
      url-base: https://github.com/zmkfirmware
    - name: manna-harbour
      url-base: https://github.com/manna-harbour
  projects:
    - name: zmk
      remote: zmkfirmware
      revision: v0.3
      import: app/west.yml
    - name: miryoku_zmk
      remote: manna-harbour
      revision: master
  self:
    path: config
```
